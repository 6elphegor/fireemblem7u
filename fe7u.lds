OUTPUT_ARCH(arm)
ENTRY(_entry)

INCLUDE symbols.ld

SECTIONS
{
    . = 0x08000000;

    .text :
    {
        build/asm/crt0.o(.text);
        build/src/main.o(.text);
        build/src/irq.o(.text);
        build/src/random.o(.text);
        build/src/hardware.o(.text);
        build/src/move-data.o(.text);
        build/src/oam.o(.text);
        build/src/soundwrapper.o(.text);
        build/src/ramfunc.o(.text);
        build/src/proc.o(.text);
        build/src/icon.o(.text);
        build/src/text.o(.text);
        build/src/anime.o(.text);
        build/src/sprite.o(.text);
        build/src/face.o(.text);
        build/src/talk.o(.text);
        build/src/talk-advance.o(.text);
        build/src/event.o(.text);
        build/src/event-engine.o(.text);
        build/src/eventscr.o(.text);
        build/src/eventscr2.o(.text);
        build/src/eventscr3.o(.text);
        build/src/eventscr4.o(.text);
        build/src/eventscr_browntextbox.o(.text);
        build/src/eventscr_bgtransition.o(.text);
        build/src/eventscr_snowstormfx.o(.text);
        build/src/eventscr_thunderfx.o(.text);
        build/src/eventscr_niniandisp.o(.text);
        build/src/eventscr_screenflashfx.o(.text);
        build/src/eventscr_fadefx.o(.text);
        build/src/eventscr_spriteanim.o(.text);
        build/src/sprite-anim.o(.text);
        build/src/game-ctrl.o(.text);
        build/src/msg.o(.text);
        build/src/bmlib.o(.text);
        build/src/bmlib-math.o(.text);
        build/src/bm.o(.text);
        build/src/bmitem.o(.text);
        build/src/unit.o(.text);
        build/src/bmmap.o(.text);
        build/src/bmidoten.o(.text);
        build/src/bmdebug.o(.text);
        build/src/playerphase.o(.text);
        build/src/koido.o(.text);
        build/src/bmxfade.o(.text);
        build/src/bmcamadjust.o(.text);
        build/src/convoymenu.o(.text);
        build/src/fogmap.o(.text);
        build/src/menuitempanel.o(.text);
        build/src/prep_unitswap.o(.text);
        build/src/phasechangefx.o(.text);
        build/src/unit_facing.o(.text);
        build/src/trapfx.o(.text);
        build/src/popup2.o(.text);
        build/src/bmfx-chapterintrofx.o(.text);
        build/src/gameoverbgfx.o(.text);
        build/src/lightrunefx.o(.text);
        build/src/danceringfx.o(.text);
        build/src/eventwarpfx.o(.text);
        build/src/bmfx_08020AD0.o(.text);
        build/src/whitecircularfadefx.o(.text);
        build/src/emitstarfx.o(.text);
        build/src/bmfx-swingsword.o(.text);
        build/src/bmfx-minefx.o(.text);
        build/src/bmfx-niniantransform.o(.text);
        build/src/bmmenu.o(.text);
        build/src/faction.o(.text);
        build/src/gold.o(.text);
        build/src/bmtarget.o(.text);
        build/src/unit-sprite.o(.text);
        build/src/support.o(.text);
        build/src/bmitemuse.o(.text);
        build/src/battle.o(.text);
        build/src/bmtrade.o(.text);
        build/src/bmtrick.o(.text);
        build/src/bmusemind.o(.text);
        build/src/bmio.o(.text);
        build/src/bmcontainer.o(.text);
        build/src/bmusort.o(.text);
        build/src/bmarena.o(.text);
        build/src/bmmind.o(.text);
        build/src/bmpatharrowdisp.o(.text);
        build/src/prep_sallycursor.o(.text);
        build/src/bmcommanddbg.o(.text);
        build/src/chapterdata.o(.text);
        build/src/unitinfowindow.o(.text);
        build/src/bb.o(.text);
        build/src/bmusailment.o(.text);
        build/src/bksel.o(.text);
        build/src/bmtrap.o(.text);
        build/src/bmarch.o(.text);
        build/src/bmdifficulty.o(.text);
        build/src/cp_phase.o(.text);
        build/src/cp_order.o(.text);
        build/src/cp_decide.o(.text);
        build/src/cp_perform.o(.text);
        build/src/cp_utility.o(.text);
        build/src/cp_script.o(.text);
        build/src/cp_battle.o(.text);
        build/src/cp_0803E2F4.o(.text);
        build/src/cp_staff.o(.text);
        build/src/cpextra_80407F0.o(.text);
        build/src/sio_core.o(.text);
        build/src/sio_main.o(.text);
        build/src/sio_main2.o(.text);
        build/src/sio_teamlist.o(.text);
        build/src/sio_tactician.o(.text);
        build/src/sio_postbattle.o(.text);
        build/src/sio_bat.o(.text);
        build/src/sio_term.o(.text);
        build/src/sio_result.o(.text);
        build/src/sio_rulesettings.o(.text);
        build/src/sio_menu.o(.text);
        build/src/sio_event.o(.text);
        build/src/fe6link.o(.text);
        build/src/sio_points.o(.text);
        build/src/sio_battlemap.o(.text);
        build/src/sio_080470B8.o(.text);
        build/src/sio_mu.o(.text);
        build/src/sio_uiutils.o(.text);
        build/src/sio_menudef.o(.text);
        build/src/sio_multiboot.o(.text);
        build/src/ui.o(.text);
        build/src/uimenu.o(.text);
        build/src/uiselecttarget.o(.text);
        build/src/banim-ekrbattle.o(.text);
        build/src/banim-ekrlvupfan.o(.text);
        build/src/banim-ekrgauge.o(.text);
        build/src/banim-ekrdispup.o(.text);
        build/src/banim-efxhpbar.o(.text);
        build/src/banim-efxdeath.o(.text);
        build/src/banim-efxbattle.o(.text);
        build/src/banim-efxflashbg.o(.text);
        build/src/banim-efxflashunit.o(.text);
        build/src/banim-efxstatusunit.o(.text);
        build/src/banim-efxflashobj.o(.text);
        build/src/banim-ekrutils.o(.text);
        build/src/banim-ekrbattlestarting.o(.text);
        build/src/banim-ekrbattleending.o(.text);
        build/src/banim-ekrbattleintro.o(.text);
        build/src/banim-battleparse.o(.text);
        build/src/banim-ekrcmd.o(.text);
        build/src/banim-main.o(.text);
        build/src/banim-mainutils.o(.text);
        build/src/banim-ekrmainmini.o(.text);
        build/src/banim-ekrarena.o(.text);
        build/src/banim-efxmagic.o(.text);
        build/src/banim-efxmagic-phywpn.o(.text);
        build/src/banim-efxmagic-refresh.o(.text);
        build/src/banim-efxmagic-ballista.o(.text);
        build/src/banim-efxmagic-spell11.o(.text);
        build/src/banim-efxmagic-hurtmut.o(.text);
        build/src/banim-efxmagic-breath.o(.text);
        build/src/banim-efxmagic-thunder.o(.text);
        build/src/banim-efxmagic-fire.o(.text);
        build/src/banim-efxmagic-fimbulvetr.o(.text);
        build/src/banim-efxmagic-bolting.o(.text);
        build/src/banim-efxmagic-flux.o(.text);
        build/src/banim-efxmagic-nosferatu.o(.text);
        build/src/banim-efxmagic-light.o(.text);
        build/src/banim-efxmagic-bolganone.o(.text);
        build/src/banim-efxmagic-divine.o(.text);
        build/src/banim-efxmagic-spell21.o(.text);
        build/src/banim-efxmagic-eclipse.o(.text);
        build/src/banim-efxmagic-fenrir.o(.text);
        build/src/banim-efxmagic-healstaves.o(.text);
        build/src/banim-efxmagic-effectstaves.o(.text);
        build/src/banim-efxmagic-shine.o(.text);
        build/src/banim-efxmagic-luna.o(.text);
        build/src/banim-efxmagic-excalibur.o(.text);
        build/src/banim-efxmagic-gespenst.o(.text);
        build/src/banim-efxmagic-aura.o(.text);
        build/src/banim-efxmagic-luce.o(.text);
        build/src/banim-efxmagic-ereshkigal.o(.text);
        build/src/banim-efxmagic-dancerings.o(.text);
        build/src/banim-efxhit.o(.text);
        build/src/banim-efxmisc.o(.text);
        build/src/banim-efxdrsmmoya.o(.text);
        build/src/banim-efxop.o(.text);
        build/src/banim-ekrdragon.o(.text);
        build/src/banim-ekrdragonfx.o(.text);
        build/src/banim-efxutils.o(.text);
        build/src/banim-efxsound.o(.text);
        build/src/banim-ekrclasschg.o(.text);
        build/src/banim-ekrlvup.o(.text);
        build/src/banim-efxlvup.o(.text);
        build/src/banim-ekrtriangle.o(.text);
        build/src/banim-ekrpopup.o(.text);
        build/src/banim-ekrhensei.o(.text);
        build/src/spellassoc.o(.text);
        build/src/mu.o(.text);
        build/src/mapanim.o(.text);
        build/src/mapanim_api.o(.text);
        build/src/mapanim_infobox.o(.text);
        build/src/mapanim_expbar.o(.text);
        build/src/mapanim_debug.o(.text);
        build/src/mapanim_specialeffect.o(.text);
        build/src/mapanim_staffeffect.o(.text);
        build/src/mapanim_lvupfx.o(.text);
        build/src/mapanim_lvup.o(.text);
        build/src/mapanim_spellassocfx.o(.text);
        build/src/mapanim_spellassoc.o(.text);
        build/src/scanline.o(.text);
        build/src/eventinfo.o(.text);
        build/src/eventcall.o(.text);
        build/src/eventcall_quakefx.o(.text);
        build/src/eventcall_dragongate.o(.text);
        build/src/eventcall_dragonflamefx.o(.text);
        build/src/eventcall_zephielepilogue.o(.text);
        build/src/quintessence-fx.o(.text);
        build/src/eventcall_unittornout.o(.text);
        build/src/eventcall_flamebreath.o(.text);
        build/src/eventcall_flamebreath_2.o(.text);
        build/src/eventcall_icecrystal.o(.text);
        build/src/eventcall_0807C8B4.o(.text);
        build/src/eventcall_worldflush.o(.text);
        build/src/eventcall_0807CEC8.o(.text);
        build/src/eventcall_ninian.o(.text);
        build/src/eventcall_0807D9E4.o(.text);
        build/src/eventcall_firedragonsprite.o(.text);
        build/src/eventcall_0807F9EC.o(.text);
        build/src/statscreenfx.o(.text);
        build/src/statscreen-util.o(.text);
        build/src/statscreen.o(.text);
        build/src/statscreen-helpbox.o(.text);
        build/src/chapter-title.o(.text);
        build/src/helpbox.o(.text);
        build/src/player_interface.o(.text);
        build/src/sioerror.o(.text);
        build/src/uichapterstatus.o(.text);
        build/src/cgtext.o(.text);
        build/src/unitlistscreen.o(.text);
        build/src/prepscreen.o(.text);
        build/src/preputil_atmenuitem.o(.text);
        build/src/preputil_unitlist.o(.text);
        build/src/prep_atmenu.o(.text);
        build/src/prepscreenfx.o(.text);
        build/src/prep_menu.o(.text);
        build/src/prep_menuscroll.o(.text);
        build/src/prep_bgscroll.o(.text);
        build/src/prep_sallycir.o(.text);
        build/src/prep_utils.o(.text);
        build/src/prep_itemscreen.o(.text);
        build/src/prep_unitselect.o(.text);
        build/src/prep_itemtrade.o(.text);
        build/src/prep_itemuse.o(.text);
        build/src/prep_itemusemind.o(.text);
        build/src/prep_itemsupply.o(.text);
        build/src/prep_itemlist.o(.text);
        build/src/prep_itemsell.o(.text);
        build/src/prep_fortune.o(.text);
        build/src/prep_8099358.o(.text);
        build/src/uisupport.o(.text);
        build/src/prep_password.o(.text);
        build/src/save_core.o(.text);
        build/src/bmsave-lib.o(.text);
        build/src/bmsave-bwl.o(.text);
        build/src/bmsave.o(.text);
        build/src/bmsave-multiarena.o(.text);
        build/src/minimap.o(.text);
        build/src/savemenu.o(.text);
        build/src/savedraw.o(.text);
        build/src/savedrawfx.o(.text);
        build/src/savemenu_difficulty.o(.text);
        build/src/savemenu_tactician.o(.text);
        build/src/savemenu_modeselect.o(.text);
        build/src/scrolling_util.o(.text);
        build/src/cursor-hand.o(.text);
        build/src/spinning_arrow.o(.text);
        build/src/sysutil.o(.text);
        build/src/bonusclaim_helpbox.o(.text);
        build/src/soundroom.o(.text);
        build/src/extramenu_unk.o(.text);
        build/src/bonusclaim.o(.text);
        build/src/uiconfig.o(.text);
        build/src/colorfade.o(.text);
        build/src/lord-select.o(.text);
        build/src/opinfo.o(.text);
        build/src/classdisplayfont.o(.text);
        build/src/bmshop.o(.text);
        build/src/uiarena.o(.text);
        build/src/worldmap.o(.text);
        build/src/gamerankings.o(.text);
        build/src/cg.o(.text);
        build/src/epilogue.o(.text);
        build/src/ending_details.o(.text);
        build/src/titlescreen.o(.text);
        build/src/opanim_scanline.o(.text);
        build/src/opanim.o(.text);
        build/asm/m4a.o(.text);
        build/asm/libagb.o(.text);
        *libgcc.a:_ashldi3.o(.text);
        *libgcc.a:_call_via_rX.o(.text);
        *libgcc.a:_divsi3.o(.text);
        *libgcc.a:_dvmd_tls.o(.text);
        *libgcc.a:_modsi3.o(.text);
        *libgcc.a:_muldi3.o(.text);
        *libgcc.a:_udivsi3.o(.text);
        *libgcc.a:_umodsi3.o(.text);
        *libc.a:memcpy.o(.text);
        *libc.a:memset.o(.text);
        *libc.a:sprintf.o(.text);
        *libc.a:strcpy.o(.text);
        *libc.a:strlen.o(.text);
        *libc.a:vfprintf.o(.text);
        *libc.a:wsetup.o(.text);
        *libc.a:dtoa.o(.text);
        *libc.a:fflush.o(.text);
        *libc.a:findfp.o(.text);
        *libc.a:freer.o(.text);
        *libc.a:fvwrite.o(.text);
        *libc.a:fwalk.o(.text);
        *libc.a:locale.o(.text);
        *libc.a:makebuf.o(.text);
        *libc.a:mallocr.o(.text);
        *libc.a:mbtowc_r.o(.text);
        *libc.a:memchr.o(.text);
        *libc.a:memmove.o(.text);
        *libc.a:mlock.o(.text);
        *libc.a:mprec.o(.text);
        *libc.a:s_isinf.o(.text);
        *libc.a:s_isnan.o(.text);
        *libc.a:sbrkr.o(.text);
        *libc.a:stdio.o(.text);
        *libc.a:strcmp.o(.text);
        *libc.a:syscalls.o(.text);
        *libc.a:writer.o(.text);
        *libc.a:callocr.o(.text);
        *libc.a:closer.o(.text);
        *libc.a:errno.o(.text);
        *libc.a:fstatr.o(.text);
        *libc.a:libcfunc.o(.text);
        *libc.a:lseekr.o(.text);
        *libc.a:readr.o(.text);
        *libgcc.a:dp-bit.o(.text);
        *libgcc.a:fp-bit.o(.text);
        *libgcc.a:_lshrdi3.o(.text);
        *libgcc.a:_negdi2.o(.text);
        build/asm/veneers.o(.text);
    } = 0

    .rodata :
    {
        INCLUDE build/layout.ld
    } = 0

    INCLUDE build/ram.ld

    /DISCARD/ :
    {
        *(*);
    }
}
